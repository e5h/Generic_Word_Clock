## esp32-c3-web/components/wifi/Kconfig.projbuild
```kconfig
menu "WiFi Connection Settings"

    config ESP_WIFI_SSID
        string "WiFi SSID"
        default "myssid"
        help
            SSID (network name) for the application to connect to.

    config ESP_WIFI_PASSWORD
        string "WiFi Password"
        default "mypassword"
        help
            WiFi password for the application to use.

    config ESP_MAXIMUM_RETRY
        int "Maximum WiFi Reconnection Attempts"
        default 10
        help
            Maximum number of reconnection attempts when the application disconnects in STA mode.

    config ESP_DEV_HOSTNAME
        string "Device Hostname"
        default "espressif"
        help
            Device hostname (eg. espressif.lan) to be assigned on the local network.

    choice ESP_WIFI_AUTH_MODE
        prompt "WiFi Authentication Mode"
        default ESP_WIFI_AUTH_WPA2_PSK
        help
            The weakest WiFi auth mode to accept.

        config ESP_WIFI_AUTH_OPEN
            bool "OPEN"
        config ESP_WIFI_AUTH_WEP
            bool "WEP"
        config ESP_WIFI_AUTH_WPA_PSK
            bool "WPA PSK"
        config ESP_WIFI_AUTH_WPA2_PSK
            bool "WPA2 PSK"
        config ESP_WIFI_AUTH_WPA_WPA2_PSK
            bool "WPA/WPA2 PSK"
        config ESP_WIFI_AUTH_WPA3_PSK
            bool "WPA3 PSK"
        config ESP_WIFI_AUTH_WPA2_WPA3_PSK
            bool "WPA2/WPA3 PSK"
        config ESP_WIFI_AUTH_WAPI_PSK
            bool "WAPI PSK"
    endchoice

endmenu
```

## esp32-c3-web/main/Kconfig.projbuild
```kconfig
menu "Word Clock Settings"

    config ESP_NTP_SERVER_IP
        string "NTP Time Server Address"
        default "0.pool.ntp.org"
        help
            Server used for synchronizing time via NTP.

    config ESP_NTP_REFRESH_INTERVAL
        int "NTP Time Refresh Interval (ms)"
        default 36000000
        help
            Refresh time used for the NTP time synchronization. Default = 1 hour.

endmenu

menu "Time Zone Configuration"

config DST_START
    string "Daylight Savings Time Start Date"
    default "M3.2.0"
    help
        Set the rule for when DST starts. Format: M[mth].[week].[day]

config DST_END
    string "Daylight Savings Time End Date"
    default "M11.1.0"
    help
        Set the rule for when DST ends. Format: M[mth].[week].[day]

choice
    prompt "Select Time Zone"
    default ESP_TZ_STRING_CUT0GDT

config ESP_TZ_STRING_CUT0GDT
    bool "Coordinated Universal Time (CUT)"
    help
        CUT0GDT
        Coordinated Universal Time

config ESP_TZ_STRING_GMT0BST
    bool "United Kingdom (CUT)"
    help
        GMT0BST
        United Kingdom

config ESP_TZ_STRING_AZOREST1AZOREDT
    bool "Azores, Cape Verde (CUT -1)"
    help
        AZOREST1AZOREDT
        Azores, Cape Verde

config ESP_TZ_STRING_FALKST2FALKDT
    bool "Falkland Islands (CUT -2)"
    help
        FALKST2FALKDT
        Falkland Islands

config ESP_TZ_STRING_GRNLNDST3GRNLNDDT
    bool "Greenland, East Brazil (CUT -3)"
    help
        GRNLNDST3GRNLNDDT
        Greenland, East Brazil

config ESP_TZ_STRING_AST4ADT
    bool "Central Brazil (CUT -4)"
    help
        AST4ADT
        Central Brazil

config ESP_TZ_STRING_EST5EDT
    bool "Eastern United States, Colombia (CUT -5)"
    help
        EST5EDT
        Eastern United States, Colombia

config ESP_TZ_STRING_CST6CDT
    bool "Central United States, Honduras (CUT -6)"
    help
        CST6CDT
        Central United States, Honduras

config ESP_TZ_STRING_MST7MDT
    bool "Mountain United States (CUT -7)"
    help
        MST7MDT
        Mountain United States

config ESP_TZ_STRING_PST8PDT
    bool "Pacific United States, Yukon (CUT -8)"
    help
        PST8PDT
        Pacific United States, Yukon

config ESP_TZ_STRING_AST9ADT_ALASKA
    bool "Alaska (CUT -9)"
    help
        AST9ADT
        Alaska

config ESP_TZ_STRING_HST10HDT
    bool "Hawaii, Aleutian Islands (CUT -10)"
    help
        HST10HDT
        Hawaii, Aleutian Islands

config ESP_TZ_STRING_BST11BDT
    bool "Bering Strait (CUT -11)"
    help
        BST11BDT
        Bering Strait

config ESP_TZ_STRING_NZST_12NZDT
    bool "New Zealand (CUT +12)"
    help
        NZST-12NZDT
        New Zealand

config ESP_TZ_STRING_MET_11METDT
    bool "Solomon Islands (CUT +11)"
    help
        MET-11METDT
        Solomon Islands

config ESP_TZ_STRING_EET_10EETDT
    bool "Eastern Australia (CUT +10)"
    help
        EET-10EETDT
        Eastern Australia

config ESP_TZ_STRING_JST_9JSTDT
    bool "Japan (CUT +9)"
    help
        JST-9JSTDT
        Japan

config ESP_TZ_STRING_KORST_9KORDT
    bool "Korea (CUT +9)"
    help
        KORST-9KORDT
        Korea

config ESP_TZ_STRING_WAUST_8WAUDT
    bool "Western Australia (CUT +8)"
    help
        WAUST-8WAUDT
        Western Australia

config ESP_TZ_STRING_TAIST_8TAIDT
    bool "Taiwan (CUT +8)"
    help
        TAIST-8TAIDT
        Taiwan

config ESP_TZ_STRING_THAIST_7THAIDT
    bool "Thailand (CUT +7)"
    help
        THAIST-7THAIDT
        Thailand

config ESP_TZ_STRING_TASHST_6TASHDT
    bool "Central Asia (CUT +6)"
    help
        TASHST-6TASHDT
        Central Asia

config ESP_TZ_STRING_PAKST_5PAKDT
    bool "Pakistan (CUT +5)"
    help
        PAKST-5PAKDT
        Pakistan

config ESP_TZ_STRING_WST_4WDT
    bool "Gorki, Central Asia, Oman (CUT +4)"
    help
        WST-4WDT
        Gorki, Central Asia, Oman

config ESP_TZ_STRING_MEST_3MEDT
    bool "Turkey (CUT +3)"
    help
        MEST-3MEDT
        Turkey

config ESP_TZ_STRING_SAUST_3SAUDT
    bool "Saudi Arabia (CUT +3)"
    help
        SAUST-3SAUDT
        Saudi Arabia

config ESP_TZ_STRING_WET_2WET
    bool "Finland (CUT +2)"
    help
        WET-2WET
        Finland

config ESP_TZ_STRING_USAST_2USADT
    bool "South Africa (CUT +2)"
    help
        USAST-2USADT
        South Africa

config ESP_TZ_STRING_NFT_1DFT
    bool "Norway (CUT +1)"
    help
        NFT-1DFT
        Norway

endchoice

endmenu
```
